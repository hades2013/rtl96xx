## product/access/kernel/linux-2.6.x/drivers/net/rtl86900/romeDriver/Kconfig
```kconfig
#
# Apollo RomeDriver configuration
#

#choice
#	prompt "Realtek RG Environment Selection"

#config RG_API_RLE0371
#	bool "RTK RG APIs for Chip A1"
#	select APOLLO
#	select APOLLO_DRIVER_TESTCHIP
#	select APOLLO_RLE0371

config RG_API_RLE0601
        bool #"RTK RG APIs for Chip B0"
	default y
	select APOLLO
	select APOLLO_RLE0601

#endchoice


choice
        prompt "Realtek RG API Type Selection"

config APOLLO_ROMEDRIVER
        bool "RomeDriver APIs"
	select RG_LAYER2_SOFTWARE_LEARN

config APOLLO_LITEROMEDRIVER
        bool "Lite RomeDriver APIs"

endchoice

config RG_DEBUG
	bool "Realtek RG debug tools"
	default y

config RG_NAPT_TCP_AUTO_LEARN
	bool "Realtek RG NAPT TCP auto learning by Forwarding Engine"
	depends on APOLLO_ROMEDRIVER
	default y

config RG_NAPT_UPNP_SUPPORT
	bool "Realtek RG NAPT UPNP support by Forwarding Engine"
	depends on RG_NAPT_TCP_AUTO_LEARN
	select RG_NAPT_INBOUND_TRACKING
	default y

config RG_NAPT_VIRTUAL_SERVER_SUPPORT
	bool "Realtek RG NAPT Virtual Server support by Forwarding Engine"
	depends on RG_NAPT_TCP_AUTO_LEARN
	select RG_NAPT_INBOUND_TRACKING
	default y

config RG_NAPT_DMZ_SUPPORT
	bool "Realtek RG NAPT DMZ support by Forwarding Engine"
	depends on RG_NAPT_TCP_AUTO_LEARN
	select RG_NAPT_INBOUND_TRACKING
	default y

config RG_NAPT_ARP_AUTO_LEARN
	bool "Realtek RG ARP auto learning by Forwarding Engine"
	depends on APOLLO_ROMEDRIVER
	default y

config RG_IPV6_NEIGHBOR_AUTO_LEARN
        bool "Realtek RG Neighbor auto learning by Forwarding Engine"
        depends on APOLLO_ROMEDRIVER
        default y

config RG_WLAN_HWNAT_ACCELERATION
	bool "Realtek RG Master CPU WLAN HWNAT acceleration"
	depends on APOLLO_ROMEDRIVER
	default y

config RG_LAYER2_ARP_NEIGHBOR_AUTO_AGENT
	bool "Realtek RG Layer 2, ARP, Neighbor auto learning"
	depends on APOLLO_LITEROMEDRIVER
	default n
	---help---
          This option will turn off hardware auto-learning, then
	  the agent will sync layer 2 table between software and
	  hardware, and handling ARP and IPv6 Neighbor protocol.

config RG_NAPT_AUTO_AGEOUT
	bool "Realtek RG NAPT auto age out by Forwarding Engine"
	default y

config RG_ARP_AUTO_AGEOUT
	bool "Realtek RG ARP auto age out by Forwarding Engine"
	default y

config RG_CALLBACK
        bool "Realtek RG callback function Enable"
        default y

config RG_PPPOE_PASSTHROUGHT
        bool "Realtek RG PPPoE Passthrought Enable"
        default y


if !RTL_MULTI_ETH_WAN
config RG_SIMPLE_PROTOCOL_STACK
	bool "Realtek RG Simple Protocol Stack settings"
	default n
	---help---
	  This option will set NIC driver as simple mode, let
	  fwdEngine do all the work for it, either rx or tx.
	  
	  NOTICE:if this option is used, please rebuild user
	  space application "spppd" for supporting simple protocol
	  stack.
endif

config APOLLO
	bool

config APOLLO_DRIVER_TESTCHIP
	bool

config APOLLO_RLE0371
	bool

config APOLLO_RLE0601
	bool

config RG_NAPT_INBOUND_TRACKING
	bool

config RG_LAYER2_SOFTWARE_LEARN
	bool
```

## product/access/kernel/rtk_voip.bak/aipc_char/Kconfig
```kconfig
menu "RTL8686 IPC"

# ---------------------------------------------------------------------
# IPC ASIC or FPGA config

comment "IPC ASIC or FPGA config"

menu "RTL8686 ASIC or FPGA"
choice 
	prompt "RTL8686 Chip Type"
	default y

config RTL8686_ASIC
	bool  "Support for RTL8686_ASIC"
	default y

config RTL8686_FPGA
	bool  "Support for RTL8686_FPGA"
	default n

endchoice

menu "RTL8686 DRAM SIZE"
config RTL8686_DRAM_64_MB
	bool  "Support for DRAM 64 MB"
	default y

config RTL8686_DRAM_32_MB
	bool  "Support for DRAM 32 MB"
	default n

endmenu

menu "RTL8686 Test IP"

config RTL8686_TEST_IP
	bool "RTL8686 TEST IP"
	default n

config RTL8686_ASIC_TEST_IP
	bool  "Support for RTL8686_ASIC_TEST_IP"
	depends on RTL8686_TEST_IP
	default n

config RTL8686_FPGA_TEST_IP
	bool  "Support for RTL8686_FPGA_TEST_IP"
	depends on RTL8686_TEST_IP
	default n

endmenu

menu "RTL8686 Read Write Test"

config RTL8686_READ_WRITE_TEST
	bool "RTL8686 Read Write test"
	default n

config RTL8686_READ_DRAM_THREAD
	bool  "Support for RTL8686_READ_TEST"
	depends on RTL8686_READ_WRITE_TEST
	default n

config RTL8686_WRITE_DRAM_THREAD
	bool  "Support for RTL8686_FPGA_TESTP"
	depends on RTL8686_READ_WRITE_TEST
	default n

endmenu

endmenu

# ---------------------------------------------------------------------
# IPC Main Function

comment "IPC Main Function"

menu "RTL8686 IPC interface"
config RTL8686_IPC_DEV
	bool "RTL8686 IPC interface"
	default y

config RTL8686_IPC_PROCESSOR
    int "RTL8686 IPC processor"
    default 0
    depends on RTL8686_IPC_DEV

config RTL8686_IPC_DEBUG_MESSAGE
    bool "RTL8686 IPC debug message"
    default y
    depends on RTL8686_IPC_DEV

config RTL8686_SHM_NOTIFY
	bool  "Shared memory notify"
	depends on RTL8686_IPC_DEV
	default n

# ---------------------------------------------------------------------
# IPC Shared Memory Setting

comment "IPC Shared Memory Setting"

menu "RTL8686 SHM Setting"

config RTL8686_SHM_SETTING
	bool "RTL8686 SHM Setting"
	default y

config RTL8686_CPU_MEM_BASE
	hex  "RTL8686 CPU MEM Base"
	depends on RTL8686_SHM_SETTING
	default 0x00000000

config RTL8686_CPU_MEM_SIZE
	hex  "RTL8686 CPU MEM Size"
	depends on RTL8686_SHM_SETTING
	default 0x02000000

config RTL8686_IPC_MEM_BASE
	hex  "RTL8686 IPC MEM Base"
	depends on RTL8686_SHM_SETTING
	default 0x03000000

config RTL8686_IPC_MEM_SIZE
	hex  "RTL8686 IPC MEM Size"
	depends on RTL8686_SHM_SETTING
	default 0x00100000

config RTL8686_DSP_MEM_BASE
	hex  "RTL8686 DSP MEM Base"
	depends on RTL8686_SHM_SETTING
	default 0x03100000

config RTL8686_DSP_MEM_SIZE
	hex  "RTL8686 DSP MEM Size"
	depends on RTL8686_SHM_SETTING
	default 0x00F00000

endmenu

# ---------------------------------------------------------------------
# SLIC Reset 

menu "RTL8686 SLIC Reset"

config RTL8686_SLIC_RESET
	bool "RTL8686 SLIC RESET"
	default y

config RTL8686_SLIC_RESET_GPIO_NUM
	int "RTL8686 SLIC RESET GPIO NUM"
	depends on RTL8686_SLIC_RESET
	default 17
	range 0 64

endmenu

# ---------------------------------------------------------------------
# IPC Debug  

comment "IPC Debug"

config RTL8686_IPC_RECORD_DSP_LOG
	bool "RTL8686 IPC Record DSP log"
	default y
	help
		Get DSP console logs from CPU side. 

# ---------------------------------------------------------------------
# IPC Test Codes

comment "IPC Test Codes"

config RTL8686_IPC_TEST_THREAD
    bool "RTL8686 IPC test thread"
    default n
    depends on RTL8686_IPC_DEV

config RTL8686_IPC_TEST_THREAD_2
    bool "RTL8686 IPC test thread 2"
    default n
    depends on RTL8686_IPC_TEST_THREAD

config RTL8686_IPC_TEST_THREAD_3
    bool "RTL8686 IPC test thread 3"
    default n
    depends on RTL8686_IPC_TEST_THREAD_2

endmenu

endmenu
```

## product/access/kernel/rtk_voip/aipc_char/Kconfig
```kconfig
menu "RTL8686 IPC"
	depends on RTK_VOIP

# ---------------------------------------------------------------------
# IPC ASIC or FPGA config

comment "IPC ASIC or FPGA config"

menu "RTL8686 ASIC or FPGA"
choice 
	prompt "RTL8686 Chip Type"
	default y

config RTL8686_ASIC
	bool  "Support for RTL8686_ASIC"
	default y

config RTL8686_FPGA
	bool  "Support for RTL8686_FPGA"
	default n

endchoice

menu "RTL8686 Test IP"

config RTL8686_TEST_IP
	bool "RTL8686 TEST IP"
	default n

config RTL8686_ASIC_TEST_IP
	bool  "Support for RTL8686_ASIC_TEST_IP"
	depends on RTL8686_TEST_IP
	default n

config RTL8686_FPGA_TEST_IP
	bool  "Support for RTL8686_FPGA_TEST_IP"
	depends on RTL8686_TEST_IP
	default n

endmenu

endmenu

# ---------------------------------------------------------------------
# IPC Main Function

comment "IPC Main Function"

menu "RTL8686 IPC interface"
config RTL8686_IPC_DEV
	bool "RTL8686 IPC interface"
	default n

config RTL8686_IPC_PROCESSOR
    int "RTL8686 IPC processor"
    default 0
    depends on RTL8686_IPC_DEV

config RTL8686_IPC_DUAL_LINUX
    bool "RTL8686 Dual Linux"
    default n
    depends on RTL8686_IPC_DEV
#   depends on RTL8686_IPC_DEV && LUNA_DUAL_LINUX

config RTL8686_IPC_DEBUG_MESSAGE
    bool "RTL8686 IPC debug message"
	depends on RTL8686_IPC_DEV
	default y

config RTL8686_SHM_NOTIFY
	bool  "RTL8686 Shared memory notify"
	depends on RTL8686_IPC_DEV 
	default y

# ---------------------------------------------------------------------
# IPC Shared Memory Setting
#
#comment "RTL8686 IPC Shared Memory Setting"
#depends on RTL8686_IPC_DEV && RTL8686_IPC_PROCESSOR = 1
#
#menu "RTL8686 SHM Setting"
#depends on RTL8686_IPC_DEV && RTL8686_IPC_PROCESSOR = 1
#
#config RTL8686_SHM_SETTING
#	bool "RTL8686 SHM Setting"
#	depends on RTL8686_IPC_DEV && RTL8686_IPC_PROCESSOR = 1
#	default y
#
#config RTL8686_CPU_MEM_BASE
#	hex  "RTL8686 CPU MEM Base"
#	depends on RTL8686_SHM_SETTING
#	default 0x00000000
#
#config RTL8686_CPU_MEM_SIZE
#	hex  "RTL8686 CPU MEM Size"
#	depends on RTL8686_SHM_SETTING && RTL8686_IPC_PROCESSOR = 1
#	default 0x03800000
#
#config RTL8686_IPC_MEM_BASE
#	hex  "RTL8686 IPC MEM Base"
#	depends on RTL8686_SHM_SETTING && RTL8686_IPC_PROCESSOR = 1
#	default 0x03800000
#
#config RTL8686_IPC_MEM_SIZE
#	hex  "RTL8686 IPC MEM Size"
#	depends on RTL8686_SHM_SETTING && RTL8686_IPC_PROCESSOR = 1
#	default 0x00100000
#
#config RTL8686_DSP_MEM_BASE
#	hex  "RTL8686 DSP MEM Base"
#	depends on RTL8686_SHM_SETTING && RTL8686_IPC_PROCESSOR = 1
#	default 0x03900000
#
#config RTL8686_DSP_MEM_SIZE
#	hex  "RTL8686 DSP MEM Size"
#	depends on RTL8686_SHM_SETTING && RTL8686_IPC_PROCESSOR = 1
#	default 0x00700000
#
#endmenu

# ---------------------------------------------------------------------
# IPC Shared Memory Setting
#
comment "IPC Shared Memory Setting"
	depends on RTL8686_IPC_DEV
menu "RTL8686 SHM Setting"
	depends on RTL8686_IPC_DEV

config VOIP_IPC_DSP_ARCHITECTURE
	bool "voip_ipc_dsp_architecture"
	depends on RTL8686_IPC_DEV
	default y

config LUNA_DUAL_LINUX
	bool "luna_dual_linux"
	depends on RTL8686_IPC_DEV
	default n

config RTL8686_CPU_MEM_BASE
	hex  "RTL8686 CPU MEM Base"
	depends on VOIP_IPC_DSP_ARCHITECTURE
	default 0x00000000

config RTL8686_CPU_MEM_SIZE
	hex  "RTL8686 CPU MEM Size"
	depends on VOIP_IPC_DSP_ARCHITECTURE
	default 0x02000000

config RTL8686_IPC_MEM_BASE
	hex  "RTL8686 IPC MEM Base"
	depends on VOIP_IPC_DSP_ARCHITECTURE
	default 0x02000000

config RTL8686_IPC_MEM_SIZE
	hex  "RTL8686 IPC MEM Size"
	depends on VOIP_IPC_DSP_ARCHITECTURE
	default 0x00100000

config RTL8686_DSP_MEM_BASE
	hex  "RTL8686 DSP MEM Base"
	depends on VOIP_IPC_DSP_ARCHITECTURE
	default 0x02100000

config RTL8686_DSP_MEM_SIZE
	hex  "RTL8686 DSP MEM Size"
	depends on VOIP_IPC_DSP_ARCHITECTURE
	default 0x01F00000
endmenu
# ---------------------------------------------------------------------

# ---------------------------------------------------------------------
# UART1 Enable/Disable

comment "UART1 Enable/Disable"

config RTL8686_IPC_UART1_ENABLE
	bool "RTL8686 IPC UART1 Enable"
	depends on RTL8686_IPC_DEV && RTL8686_IPC_PROCESSOR = 0
	default n
	help
		Enable UART1 for DSP access

# ---------------------------------------------------------------------
# SLIC Reset 

comment "RTL8686 SLIC Reset"

config RTL8686_SLIC_RESET
	bool "RTL8686 SLIC RESET"
	depends on RTL8686_IPC_DEV && RTL8686_IPC_PROCESSOR = 0
	default n

config RTL8686_SLIC_RESET_GPIO_NUM
	int "RTL8686 SLIC RESET GPIO NUM"
	depends on RTL8686_SLIC_RESET
	default 17
	range 0 64


# ---------------------------------------------------------------------
# DSP Console

comment "DSP Console"

config RTL8686_IPC_DSP_CONSOLE
	bool "RTL8686 IPC DSP Console"
	depends on RTL8686_IPC_DEV
	default y
	help
		Access DSP Console in CPU side. 

# ---------------------------------------------------------------------
# IPC Index Use SRAM or DRAM

comment "IPC Index use SRAM or DRAM"
	depends on RTL8686_IPC_DEV

config RTL8686_IPC_IDX_USE_DRAM
	bool "RTL8686 IPC Index Use DRAM"
	depends on RTL8686_IPC_DEV
	default y

config RTL8686_IPC_IDX_USE_SRAM
	bool "RTL8686 IPC Index Use SRAM"
	depends on RTL8686_IPC_DEV && !RTL8686_IPC_IDX_USE_DRAM
	default n

config RTL8686_IPC_DSP_BOOTING_ADDRESS
	hex  "RTL8686 IPC DSP Booting Address"
	depends on RTL8686_IPC_IDX_USE_DRAM || RTL8686_IPC_IDX_USE_SRAM
	default 0x88000000
	help
		Suggest value
			Use DRAM 0x88000000
			Use SRAM 0xbf100000


# ---------------------------------------------------------------------
# IPC DSP Setting

comment "IPC DSP Config"
	depends on RTL8686_IPC_DEV

config RTL8686_IPC_DSP_CONFIG
	bool "RTL8686 IPC DSP Config"
	depends on RTL8686_IPC_DEV
	default y

config RTL8686_IPC_DSP_CONFIG_CON_CH_NUM
	int "RTL8686 IPC DSP Control Channel Number"
	depends on RTL8686_IPC_DEV && RTL8686_IPC_PROCESSOR = 0
	default 2
	range 1 2

config RTL8686_IPC_DSP_CONFIG_MIRROR_SLIC_NR
	int "RTL8686 IPC DSP Mirror SLIC Number"
	depends on RTL8686_IPC_DEV && RTL8686_IPC_PROCESSOR = 0
	default 2
	range 1 2

# ---------------------------------------------------------------------
# IPC Debug  

comment "IPC Debug"

config RTL8686_IPC_RECORD_DSP_LOG
	bool "RTL8686 IPC Record DSP log"
	depends on RTL8686_IPC_DEV
	default y
	help
		Get DSP console logs from CPU side. 

# ---------------------------------------------------------------------
# IPC Test Codes

comment "IPC Test Codes"

config RTL8686_IPC_TEST_THREAD
    bool "RTL8686 IPC test thread"
    default n
    depends on RTL8686_IPC_DEV

config RTL8686_IPC_TEST_THREAD_2
    bool "RTL8686 IPC test thread 2"
    default n
    depends on RTL8686_IPC_TEST_THREAD

config RTL8686_IPC_TEST_THREAD_3
    bool "RTL8686 IPC test thread 3"
    default n
    depends on RTL8686_IPC_TEST_THREAD_2


comment "RTL8686 DSP LED Test"
	depends on RTL8686_IPC_DEV
	#depends on RTL8686_IPC_DEV && (RTL8686_IPC_PROCESSOR != 0)

config RTL8686_DSP_LED_TEST
	bool "RTL8686 DSP LED Test"
	depends on RTL8686_IPC_DEV
	default n

config RTL8686_DSP_LED_GPIO_NUM
	int "RTL8686 DSP LED GPIO NUM"
	depends on RTL8686_DSP_LED_TEST
	default 34
	range 0 64

endmenu

endmenu
```

## product/access/sdk/realtek/sdk-1.0.0/Kconfig
```kconfig
# RTL86900 SDK configuration
#

config	MODULE_BUILD_IN
	tristate "Realtek RTL86900 SDK"
	default y
	help

	   To compile it as a module, choose M here.  If unsure, say N.

config SDK_MODULES
	bool "Support RTK Apollo Modules"
	help
	   Say Y if you want to enable RTK Apollo modules.
	
config GPON_FEATURE
        bool "Support RTK GPON"
        depends on SDK_MODULES
        help
          Say Y if your machine has pon phy port.

config RTK_OMCI
        bool "Support RTK OMCI"
        depends on GPON_FEATURE
        help
          Choice for enable RTK OMCI.

config EPON_FEATURE
	bool "Support RTK EPON"
	depends on SDK_MODULES
        help
          Say Y if your machine has EPON phy ports.

config RTK_L34_DEMO
        tristate "Support RTK L34 Lite Auto Learning"
        depends on SDK_MODULES && !RTK_L34_ENABLE
        default m
	help
          Choice for enable L34 Lite Auto Learning mechanism.

config RTK_FT2_MODULE
        bool "Support RTK FT2 module"
        depends on SDK_MODULES
        help
          Choice for enable Factory Test module.

config EXTERNAL_PHY_POLLING
	bool "Support Switch External PHY Polling"
	default n
	help
          Choice for enable external phy polling with GPIO.
```
