## kernel/lwmodule/ifm/Kconfig
```kconfig
menu "MINIWARE2 INTERFACE"

config IFM
        tristate "miniware2 interface module"
        help
         interface module support

endmenu
```

## kernel/lwmodule/l2trans/Kconfig
```kconfig
menu "L2TRANS MODULE"

config L2_HANDLE
        tristate "L2 trans module"
        help
         l2 send/receive support

endmenu
```

## product/access/boot/preloader-9607/u-boot-9607/config.in
```kconfig
mainmenu_name "U-Boot Configuration"

mainmenu_option next_comment
comment 'Board'

bool 'Standalone U-Boot' CONFIG_STANDALONE_UBOOT

if [ "$CONFIG_STANDALONE_UBOOT" = "n" ]; then
	define_bool CONFIG_RTL838XS n
	define_bool CONFIG_RTL839XS n
	define_int  CONFIG_EXCEPTION_BASE CONFIG_SYS_TEXT_BASE
	choice 'Realtek' "RTL838x  CONFIG_RTL838X
	                  RTL839x  CONFIG_RTL839X
	                  LUNA     CONFIG_LUNA"
else
	define_bool CONFIG_RTL838X n
	define_bool CONFIG_RTL839X n
	define_bool CONFIG_LUNA    n
	define_int  CONFIG_EXCEPTION_BASE 0xbf000000
	choice 'Realtek' "RTL838x  CONFIG_RTL838XS
	                  RTL839x  CONFIG_RTL839XS
	                  LUNA     CONFIG_LUNAS"
fi

if [ "$CONFIG_LUNA" = "y" ]; then
	choice 'Console' "UART0 CONFIG_UART0
	                  UART1 CONFIG_UART1" UART0
fi

comment 'U-Boot Location'
hex 'U-Boot Text Base' CONFIG_SYS_TEXT_BASE  	0x80F00000

endmenu

if [ "$CONFIG_RTL838X" = "y" ] || [ "$CONFIG_RTL838XS" = "y" ]; then
	source ./board/Realtek/rtl838x/menuconfig.in
elif [ "$CONFIG_RTL839X" = "y" ] || [ "$CONFIG_RTL839XS" = "y" ]; then
	source ./board/Realtek/rtl839x/menuconfig.in
elif [ "$CONFIG_LUNA" = "y" ] || [ "$CONFIG_LUNAS" = "y" ]; then
	source ./board/Realtek/luna/menuconfig.in
fi
```

## product/access/config.in
```kconfig
#
# For a description of the syntax of this configuration file,
# see scripts/kbuild/config-language.txt.
#

mainmenu "Configuration"

config HAVE_DOT_CONFIG
	bool
	default n
menu "Product Configuration"
#-----------------------------------------------------------
menu "Product Select"
choice
	prompt "Product Name"
	default CONFIG_PRODUCT_EPN105
	help
	  no help yet.

config CONFIG_PRODUCT_EPN105
	bool "EPN105"






endchoice
endmenu
#----Added by Einsn for EOC porting 20130418
menu "Product Board Features select"

config CONFIG_EOC_EXTEND
	bool "Modification for EOC Requirements"

endmenu
#----End 
menu "SDK Configuration"
config CONFIG_DEFAULTS_REALTEK
	bool "Select Realtek Vendor"
config CONFIG_VENDOR
	string 'realtek'
	default 'realtek'
		depends on CONFIG_DEFAULTS_REALTEK
	help
		no help yet
		
config CONFIG_DEFAULTS_REALTEK_SDK
	bool "Select Realtek SDK"
config CONFIG_SDK
	string 'sdk dir'
	default 'sdk-1.0.0'
		depends on CONFIG_DEFAULTS_REALTEK_SDK
	help
		no help yet
endmenu










menu "libc select"
config CONFIG_DEFAULTS_LIBC_UCLIBC_0_9_30
	bool "Select Uclibc 0.9.30"
config CONFIG_LIBCDIR
	string 'uClibc dir'
	default 'uClibc-0.9.28'
		depends on CONFIG_DEFAULTS_LIBC_UCLIBC_0_9_30
	help
		no help yet
endmenu







#------------------------------------------------------------
menu "System Configuration"
config CONFIG_PRODUCT_NAME
	string 'Product Name'
	default 'EPN105'
config CONFIG_COPYRIGHT_TIME
	string 'CopyRight Time'
	default '2014'
config CONFIG_COPYRIGHT_STRING
	string 'CopyRight String'
	default 'Copyright (c) 2014 Huanshun Network Co., Ltd.'
config CONFIG_RELEASE_VER
	string 'Release Version'
	default 'EPN105V100R006'
config CONFIG_DEVELOP_VER
	string 'Develop Version'
	default 'EPN105V100D011'
config CONFIG_DEVELOP_HARDWARE_VER
	string 'Develop hardware Version'
	default 'VER.B'
config CONFIG_DEFAULT_HOSTNAME
	string "default system host name"
	default "EPN105"
config DEFAULT_MANAGEIP
	string "default system management interface ip"
	default "192.168.1.98"
config DEFAULT_MANAGEMASK
	string "default system management interface mask"
	default "255.255.255.0"
config DEFAULT_MANAGEGW
	string "default system management interface gateway"
	default "192.168.1.1"
config CONFIG_PRODUCT_SERIES_AND_FACTORY_CODE
	string "product series and factory code"
	default "EP001C"
config CONFIG_PRODUCT_NAME_PRIV
	string 'Prvi Product Name'
	default 'EPN105'
config CONFIG_RELEASE_VER_PRIV
	string 'Prvi Release Version'
	default 'EPN105V100R006'
config CONFIG_DEVELOP_VER_PRIV
	string 'Prvi Develop Version'
	default 'EPN105V100D011'
menu "load manufactory"
config CONFIG_BOOT_RESTORE_APP
	bool "bootrestoreapp"
	default y
config CONFIG_BOOT_MULTI_APP
	bool "bootmultiapp"
	default n
endmenu
endmenu
endmenu

#------------------------------------------------------------
menu "Platform Configuration"


source	 "../../kconfig/master.kg"
source 	"../../kconfig/cli.kg"
source 	"../../kconfig/common.kg"
source  "../../kconfig/webs.kg"
source  "../../kconfig/diag.kg"
source  "../../kconfig/catvcom.kg"
source  "../../kconfig/ponmonitor.kg"
source  "../../kconfig/loopd.kg"
source  "../../kconfig/onu_compatible.kg"
source  "../../kconfig/priv_product_name.kg"









endmenu
```

## product/access/config/5500/config.in
```kconfig
#
# For a description of the syntax of this configuration file,
# see scripts/kbuild/config-language.txt.
#

mainmenu "Configuration"

config HAVE_DOT_CONFIG
	bool
	default n
menu "Product Configuration"
#-----------------------------------------------------------
menu "Product Select"
choice
	prompt "Product Name"
	default CONFIG_PRODUCT_5500
	help
	  no help yet.

config CONFIG_PRODUCT_5500
	bool "5500"






endchoice
endmenu
menu "SDK Configuration"
config CONFIG_DEFAULTS_REALTEK
	bool "Select Realtek Vendor"
config CONFIG_VENDOR
	string 'realtek'
	default 'realtek'
		depends on CONFIG_DEFAULTS_REALTEK
	help
		no help yet
		
config CONFIG_DEFAULTS_REALTEK_SDK
	bool "Select Realtek SDK"
config CONFIG_SDK
	string 'sdk dir'
	default 'sdk-1.0.0'
		depends on CONFIG_DEFAULTS_REALTEK_SDK
	help
		no help yet
endmenu










menu "libc select"
config CONFIG_DEFAULTS_LIBC_UCLIBC_0_9_30
	bool "Select Uclibc 0.9.30"
config CONFIG_LIBCDIR
	string 'uClibc dir'
	default 'uClibc-0.9.28'
		depends on CONFIG_DEFAULTS_LIBC_UCLIBC_0_9_30
	help
		no help yet
endmenu







#------------------------------------------------------------
menu "System Configuration"
config CONFIG_PRODUCT_NAME
	string 'Product Name'
	default '5500'
config CONFIG_COPYRIGHT_TIME
	string 'CopyRight Time'
	default '2014'
config CONFIG_COPYRIGHT_STRING
	string 'CopyRight String'
	default 'Copyright (c) 2014 CVN Corp'
config CONFIG_RELEASE_VER
	string 'Release Version'
	default 'N5500V1.0.0.1'
config CONFIG_DEVELOP_VER
	string 'Develop Version'
	default 'N5500V1.0.1A2'
config CONFIG_DEVELOP_HARDWARE_VER
	string 'Develop hardware Version'
	default 'VER.A'
config CONFIG_DEFAULT_HOSTNAME
	string "default system host name"
	default "CVN"
config DEFAULT_MANAGEIP
	string "default system management interface ip"
	default "192.168.1.248"
config DEFAULT_MANAGEMASK
	string "default system management interface mask"
	default "255.255.255.0"
config DEFAULT_MANAGEGW
	string "default system management interface gateway"
	default "192.168.1.1"
config CONFIG_PRODUCT_SERIES_AND_FACTORY_CODE
	string "product series and factory code"
	default "EP007X"
config CONFIG_PRODUCT_NAME_PRIV
	string 'Prvi Product Name'
	default '5500'
config CONFIG_RELEASE_VER_PRIV
	string 'Prvi Release Version'
	default 'N5500V1.0.0.1'
config CONFIG_DEVELOP_VER_PRIV
	string 'Prvi Develop Version'
	default 'N5500V1.0.1A2'
menu "load manufactory"
config CONFIG_BOOT_RESTORE_APP
	bool "bootrestoreapp"
	default y
config CONFIG_BOOT_MULTI_APP
	bool "bootmultiapp"
	default y
endmenu
endmenu
endmenu

#------------------------------------------------------------
menu "Platform Configuration"


source	 "../../kconfig/master.kg"
source 	"../../kconfig/cli.kg"
source 	"../../kconfig/common.kg"
source  "../../kconfig/webs.kg"
source  "../../kconfig/diag.kg"
source  "../../kconfig/sshd.kg"
source  "../../kconfig/ssl.kg"
source  "../../kconfig/ponmonitor.kg"
source  "../../kconfig/loopd.kg"










endmenu
```

## product/access/config/EPN204/config.in
```kconfig
#
# For a description of the syntax of this configuration file,
# see scripts/kbuild/config-language.txt.
#

mainmenu "Configuration"

config HAVE_DOT_CONFIG
	bool
	default n
menu "Product Configuration"
#-----------------------------------------------------------
menu "Product Select"
choice
	prompt "Product Name"
	default CONFIG_PRODUCT_EPN104
	help
	  no help yet.

config CONFIG_PRODUCT_EPN104
	bool "EPN204"

endchoice
endmenu

menu "Product switch chip select"
config CONFIG_SWITCH_CHIP_RTL8305MB
	bool "Switch chip RTL8305MB"
	default y
endmenu

menu "SDK Configuration"
config CONFIG_DEFAULTS_REALTEK
	bool "Select Realtek Vendor"
config CONFIG_VENDOR
	string 'realtek'
	default 'realtek'
		depends on CONFIG_DEFAULTS_REALTEK
	help
		no help yet
		
config CONFIG_DEFAULTS_REALTEK_SDK
	bool "Select Realtek SDK"
config CONFIG_SDK
	string 'sdk dir'
	default 'sdk-2.0.1'
		depends on CONFIG_DEFAULTS_REALTEK_SDK
	help
		no help yet
endmenu










menu "libc select"
config CONFIG_DEFAULTS_LIBC_UCLIBC_0_9_28
	bool "Select Uclibc 0.9.28"
config CONFIG_LIBCDIR
	string 'uClibc dir'
	default 'uClibc-0.9.28'
		depends on CONFIG_DEFAULTS_LIBC_UCLIBC_0_9_28
	help
		no help yet
endmenu







#------------------------------------------------------------
menu "System Configuration"
config CONFIG_PRODUCT_NAME
	string 'Product Name'
	default 'EPN204'
config CONFIG_COPYRIGHT_TIME
	string 'CopyRight Time'
	default '2013'
config CONFIG_COPYRIGHT_STRING
	string 'CopyRight String'
	default 'Copyright (c) 2013 HUANSHUN Technology Corp'
config CONFIG_RELEASE_VER
	string 'Release Version'
	default 'EPN204V100R008'
config CONFIG_DEVELOP_VER
	string 'Develop Version'
	default 'EPN204V100D010'
config CONFIG_DEVELOP_HARDWARE_VER
	string 'Develop hardware Version'
	default 'VER.A'
config CONFIG_DEFAULT_HOSTNAME
	string "default system host name"
	default "EPN204"
config DEFAULT_MANAGEIP
	string "default system management interface ip"
	default "192.168.0.200"
config DEFAULT_MANAGEMASK
	string "default system management interface mask"
	default "255.255.255.0"
config DEFAULT_MANAGEGW
	string "default system management interface gateway"
	default "192.168.0.1"
menu "load manufactory"
config CONFIG_BOOT_RESTORE_APP
	bool "bootrestoreapp"
	default y
config CONFIG_BOOT_MULTI_APP
	bool "bootmultiapp"
	default n
endmenu
endmenu
endmenu

#------------------------------------------------------------
menu "Platform Configuration"


source	 "../../kconfig/master.kg"
source 	"../../kconfig/cli.kg"
source 	"../../kconfig/opconn.kg"
source 	"../../kconfig/common.kg"
source  "../../kconfig/webs.kg"
source  "../../kconfig/bosa.kg"
source  "../../kconfig/catvcom.kg"
source  "../../kconfig/snmpd.kg"







endmenu
```

## product/access/config/HSEPN104/config.in
```kconfig
#
# For a description of the syntax of this configuration file,
# see scripts/kbuild/config-language.txt.
#

mainmenu "Configuration"

config HAVE_DOT_CONFIG
	bool
	default n
menu "Product Configuration"
#-----------------------------------------------------------
menu "Product Select"
choice
	prompt "Product Name"
	default CONFIG_PRODUCT_EPN104
	help
	  no help yet.

config CONFIG_PRODUCT_EPN104
	bool "EPON"






endchoice
endmenu

menu "Product switch chip select"
config CONFIG_SWITCH_CHIP_RTL8365MB
	bool "Switch chip RTL8365MB"
	default y
endmenu

menu "SDK Configuration"
config CONFIG_DEFAULTS_REALTEK
	bool "Select Realtek Vendor"
config CONFIG_VENDOR
	string 'realtek'
	default 'realtek'
		depends on CONFIG_DEFAULTS_REALTEK
	help
		no help yet
		
config CONFIG_DEFAULTS_REALTEK_SDK
	bool "Select Realtek SDK"
config CONFIG_SDK
	string 'sdk dir'
	default 'sdk-2.0.1'
		depends on CONFIG_DEFAULTS_REALTEK_SDK
	help
		no help yet
endmenu










menu "libc select"
config CONFIG_DEFAULTS_LIBC_UCLIBC_0_9_28
	bool "Select Uclibc 0.9.28"
config CONFIG_LIBCDIR
	string 'uClibc dir'
	default 'uClibc-0.9.28'
		depends on CONFIG_DEFAULTS_LIBC_UCLIBC_0_9_28
	help
		no help yet
endmenu







#------------------------------------------------------------
menu "System Configuration"
config CONFIG_PRODUCT_NAME
	string 'Product Name'
	default 'EPON'
config CONFIG_COPYRIGHT_TIME
	string 'CopyRight Time'
	default '2012'
config CONFIG_COPYRIGHT_STRING
	string 'CopyRight String'
	default 'Copyright (c) 2012 HUANSHUN Technology'
config CONFIG_RELEASE_VER
	string 'Release Version'
	default 'EPONV100R008'
config CONFIG_DEVELOP_VER
	string 'Develop Version'
	default 'EPONV100D008'
config CONFIG_DEFAULT_HOSTNAME
	string "default system host name"
	default "ONU"
config DEFAULT_MANAGEIP
	string "default system management interface ip"
	default "192.168.0.200"
config DEFAULT_MANAGEMASK
	string "default system management interface mask"
	default "255.255.255.0"
config DEFAULT_MANAGEGW
	string "default system management interface gateway"
	default "192.168.0.1"
menu "load manufactory"
config CONFIG_BOOT_RESTORE_APP
	bool "bootrestoreapp"
	default y
config CONFIG_BOOT_MULTI_APP
	bool "bootmultiapp"
	default y
endmenu
endmenu
endmenu

#------------------------------------------------------------
menu "Platform Configuration"


source	 "../../kconfig/master.kg"
source 	"../../kconfig/cli.kg"
source 	"../../kconfig/opconn.kg"
source 	"../../kconfig/common.kg"
source  "../../kconfig/webs.kg"
source  "../../kconfig/snmpd.kg"












endmenu
```
